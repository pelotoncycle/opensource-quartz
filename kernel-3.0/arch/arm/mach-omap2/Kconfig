## kernel-3.0/drivers/misc/ublox/Kconfig
```kconfig
#
menu "ublox neo6 GPS"
config UBLOX_GPS
	tristate "gps driver for ublox"
	help
	  This enables the GPS driver for ublox neo6 devices.
endmenu
```

## kernel-3.0/drivers/nfc/Kconfig
```kconfig
#
# Near Field Communication (NFC) devices
#

menuconfig NFC_DEVICES
	bool "Near Field Communication (NFC) devices"
	default n
	---help---
	  You'll have to say Y if your computer contains an NFC device that
	  you want to use under Linux.

	  You can say N here if you don't have any Near Field Communication
	  devices connected to your computer.

if NFC_DEVICES

config PN544_NFC
	tristate "PN544 NFC driver"
	depends on I2C
	select CRC_CCITT
	default n
	---help---
	  Say yes if you want PN544 Near Field Communication driver.
	  This is for i2c connected version. If unsure, say N here.

	  To compile this driver as a module, choose m here. The module will
	  be called pn544.

config PN544_UNI_NFC
	bool "UNI PN544 NFC Controller Driver"
	depends on I2C && GENERIC_GPIO
	default n
	---help---
	  UNI PN544 Near Field Communication controller support.

config PN544_NXP_NFC
	bool "NXP PN544 NFC Controller Driver"
	depends on I2C && GENERIC_GPIO
	default n
	---help---
	  NXP PN544 Near Field Communication controller support.

endif # NFC_DEVICES
```

## kernel-3.0/drivers/staging/thermal_framework/Kconfig.omap_thermal
```kconfig
config OMAP_THERMAL
	bool "OMAP Thermal Framework support"
	depends on THERMAL_FRAMEWORK && ARCH_OMAP4
	default y
	help
	  This is the thermal framework support for OMAP4
	  processors.

config OMAP4430_THERMAL_MINIMAL_CPU_FREQUENCY
	int "OMAP4430 minimal CPU frequency in HZ for thermal framework"
	default 800000
	depends on OMAP_THERMAL
	help
	  The minimal thermal CPU frequency limitation will be greater than this value.

config OMAP4460_THERMAL_MINIMAL_CPU_FREQUENCY
	int "OMAP4460 minimal CPU frequency in HZ for thermal framework"
	default 900000
	depends on OMAP_THERMAL
	help
	  The minimal thermal CPU frequency limitation will be greater than this value.

config OMAP4470_THERMAL_MINIMAL_CPU_FREQUENCY
	int "OMAP4470 minimal CPU frequency in HZ for thermal framework"
	default 1000000
	depends on OMAP_THERMAL
	help
	  The minimal thermal CPU frequency limitation will be greater than this value.

config OMAP_THERMAL_DEBUG
	bool "Enable OMAP thermal debug logs"
	depends on OMAP_THERMAL
	default n

config OMAP_THERMAL_DEBUG_VERBOSE
	bool "Enable OMAP thermal verbose debug logs"
	depends on OMAP_THERMAL
	default n

source "drivers/staging/thermal_framework/sensor/Kconfig.omap"
source "drivers/staging/thermal_framework/governor/Kconfig.omap"
```

## kernel-3.0/drivers/video/omap2/displays/Kconfig
```kconfig
menu "OMAP2/3 Display Device Drivers"
        depends on OMAP2_DSS

config PANEL_GENERIC_DPI
        tristate "Generic DPI Panel"
	depends on OMAP2_DSS_DPI
        help
	  Generic DPI panel driver.
	  Supports DVI output for Beagle and OMAP3 SDP.
	  Supports LCD Panel used in TI SDP3430 and EVM boards,
	  OMAP3517 EVM boards and CM-T35.

config PANEL_LGPHILIPS_LB035Q02
	tristate "LG.Philips LB035Q02 LCD Panel"
	depends on OMAP2_DSS_DPI && SPI
	help
	  LCD Panel used on the Gumstix Overo Palo35

config PANEL_SHARP_LS037V7DW01
        tristate "Sharp LS037V7DW01 LCD Panel"
        depends on OMAP2_DSS_DPI
        select BACKLIGHT_CLASS_DEVICE
        help
          LCD Panel used in TI's SDP3430 and EVM boards

config PANEL_NEC_NL8048HL11_01B
	tristate "NEC NL8048HL11-01B Panel"
	depends on OMAP2_DSS_DPI
	help
		This NEC NL8048HL11-01B panel is TFT LCD
		used in the Zoom2/3/3630 sdp boards.

config PANEL_TAAL
        tristate "Taal DSI Panel"
        depends on OMAP2_DSS_DSI
        help
          Taal DSI command mode panel from TPO.

config PANEL_TPO_TD043MTEA1
        tristate "TPO TD043MTEA1 LCD Panel"
        depends on OMAP2_DSS_DPI && SPI
        help
          LCD Panel used in OMAP3 Pandora

config PANEL_ACX565AKM
	tristate "ACX565AKM Panel"
	depends on OMAP2_DSS_SDI && SPI
	select BACKLIGHT_CLASS_DEVICE
	help
	  This is the LCD panel used on Nokia N900

config PANEL_TC358765
	tristate "Toshiba TC358765 DSI-2-LVDS chip"
	depends on OMAP2_DSS_DSI && I2C
	select BACKLIGHT_CLASS_DEVICE
	help
	  Toshiba TC358765 DSI-2-LVDS chip with 1024x768 panel
config TC358765_DEBUG
	bool "Toshiba TC358765 DSI-2-LVDS chip debug"
	depends on PANEL_TC358765 && DEBUG_FS
	help
	  Support of TC358765 DSI-2-LVDS chip register access via debugfs
	  
config PANEL_INNOCOMM_ORACLE
	tristate "InnoComm Oracle Panel"
	help
	  LCD Panel used in InnoComm Oracle board		  

config PANEL_INNOCOMM_TC978C
	tristate "InnoComm tc978c TM Panel"
	help
	  LCD Panel used in InnoComm tc978c board

	  
config PANEL_OMAP4_TALOS7
	tristate "OMAP4 Talos7 Panel"
	select OMAP2_DSS_DPI
	help
	  LCD Panel used in OMAP4 Talos7 board

config PANEL_OMAP4_TALOS10
	tristate "OMAP4 Talos10 Panel"
	select OMAP2_DSS_DPI
	help
	  LCD Panel used in OMAP4 Talos10 board

config PANEL_HV070WX1
	tristate "OMAP4 Zeus Panel"
	depends on OMAP2_DSS_DSI
	help
	  LCD Panel used in OMAP4 Zeus board

config PANEL_B101EW05
	tristate "OMAP4 AUO B101EW05 10.1-inch Panel"
	select OMAP2_DSS_DPI
	help
	  10.1-inch (1280x800) LCD panel used in OMAP4 Puzzle board

config PANEL_S194TALAA0
	tristate "OMAP4 TOVIS S194TALAA0 19.4-inch Panel"
	select OMAP2_DSS_DSI
	select PANEL_TC358765
	select TC358765_DEBUG
	help
	  19.4-inch (1920*530) LCD panel used in OMAP4 Puzzle board

config PANEL_LS047K1SX01F
	tristate "OMAP4 Saga Panel"
	depends on OMAP2_DSS_DSI
	help
	  LCD Panel used in OMAP4 Saga board

config PANEL_BF097XN
	tristate "OMAP4 CMI BF097XN  9.7-inch Panel"
	select OMAP2_DSS_DPI
	help
	  9.7-inch (1024x768) LCD panel used in OMAP4 Winmate board

config PANEL_LS047K1SX01
	tristate "OMAP4 Saga Panel with Himax driver IC"
	depends on OMAP2_DSS_DSI
	help
	  LCD Panel used in OMAP4 Saga board
endmenu
```

## kernel-3.0/drivers/video/omap2/dss/Kconfig
```kconfig
menuconfig OMAP2_DSS
        tristate "OMAP2+ Display Subsystem support (EXPERIMENTAL)"
        depends on ARCH_OMAP2PLUS
        help
	  OMAP2+ Display Subsystem support.

if OMAP2_DSS

config OMAP2_VRAM_SIZE
	int "VRAM size (MB)"
	range 0 32
	default 0
	help
	  The amount of SDRAM to reserve at boot time for video RAM use.
	  This VRAM will be used by omapfb and other drivers that need
	  large continuous RAM area for video use.

	  You can also set this with "vram=<bytes>" kernel argument, or
	  in the board file.

config OMAP2_DSS_DEBUG_SUPPORT
        bool "Debug support"
	default y
	help
	  This enables debug messages. You need to enable printing
	  with 'debug' module parameter.

config OMAP2_DSS_COLLECT_IRQ_STATS
	bool "Collect DSS IRQ statistics"
	depends on OMAP2_DSS_DEBUG_SUPPORT
	default n
	help
	  Collect DSS IRQ statistics, printable via debugfs.

	  The statistics can be found from
	  <debugfs>/omapdss/dispc_irq for DISPC interrupts, and
	  <debugfs>/omapdss/dsi_irq for DSI interrupts.

config OMAP2_DSS_ANDROID_BACKLIGHT
	bool "Android panel backlight support"
	default n
	select NEW_LEDS
	select LEDS_CLASS
	help
	  Support the Android panel backlight by the LEDS class.

config OMAP2_DSS_ANDROID_BACKLIGHT_DEBUG
	bool "Debug of the Android panel backlight"
	depends on OMAP2_DSS_ANDROID_BACKLIGHT
	default n
	help
	  Enable to debug the Android panel backlight

config OMAP2_DSS_ANDROID_BACKLIGHT_VERBOSE_DEBUG
	bool "Verbose debug of the Android panel backlight"
	depends on OMAP2_DSS_ANDROID_BACKLIGHT
	default n
	help
	  Enable to debug the Android panel backlight

config OMAP2_DSS_ANDROID_BACKLIGHT_DELAY_RESTORE_TIME
	int "The delay time (ms) to restore the Android panel backlight"
	depends on OMAP2_DSS_ANDROID_BACKLIGHT
	range 0 256
	default 0
	help
	  Enable to delay the restore of the Android panel backlight to avoid the LCD flicker

config OMAP2_DSS_ANDROID_BACKLIGHT_SKIP_FIRST_OFF
	bool "Skip the first backlight off to avoid the flicker during booting"
	depends on OMAP2_DSS_ANDROID_BACKLIGHT
	default n
	help
	  Skip the first backlight off to avoid the LCD flicker during booting

config OMAP2_DSS_DPI
	bool "DPI support"
	default y
	help
	  DPI Interface. This is the Parallel Display Interface.

config OMAP2_DSS_RFBI
	bool "RFBI support"
        default n
	help
	  MIPI DBI support (RFBI, Remote Framebuffer Interface, in Texas
	  Instrument's terminology).

	  DBI is a bus between the host processor and a peripheral,
	  such as a display or a framebuffer chip.

	  See http://www.mipi.org/ for DBI spesifications.

config OMAP2_DSS_VENC
	bool "VENC support"
        default y
	help
	  OMAP Video Encoder support for S-Video and composite TV-out.

config OMAP4_DSS_HDMI
	bool "HDMI support"
	depends on ARCH_OMAP4
	select HDMI_TI_4XXX_IP
        default y
	help
	  HDMI Interface. This adds the High Definition Multimedia Interface.
	  See http://www.hdmi.org/ for HDMI specification.

config OMAP2_DSS_SDI
	bool "SDI support"
	depends on ARCH_OMAP3
        default n
	help
	  SDI (Serial Display Interface) support.

	  SDI is a high speed one-way display serial bus between the host
	  processor and a display.

config OMAP2_DSS_DSI
	bool "DSI support"
	depends on ARCH_OMAP3 || ARCH_OMAP4
        default n
	help
	  MIPI DSI (Display Serial Interface) support.

	  DSI is a high speed half-duplex serial interface between the host
	  processor and a peripheral, such as a display or a framebuffer chip.

	  See http://www.mipi.org/ for DSI spesifications.

config OMAP2_DSS_FAKE_VSYNC
	bool "Fake VSYNC irq from manual update displays"
	default n
	help
	  If this is selected, DSI will generate a fake DISPC VSYNC interrupt
	  when DSI has sent a frame. This is only needed with DSI or RFBI
	  displays using manual mode, and you want VSYNC to, for example,
	  time animation.

config OMAP2_DSS_MIN_FCK_PER_PCK
	int "Minimum FCK/PCK ratio (for scaling)"
	range 0 32
	default 0
	help
	  This can be used to adjust the minimum FCK/PCK ratio.

	  With this you can make sure that DISPC FCK is at least
	  n x PCK. Video plane scaling requires higher FCK than
	  normally.

	  If this is set to 0, there's no extra constraint on the
	  DISPC FCK. However, the FCK will at minimum be
	  2xPCK (if active matrix) or 3xPCK (if passive matrix).

	  Max FCK is 173MHz, so this doesn't work if your PCK
	  is very high.

config OMAP2_DSS_SLEEP_AFTER_VENC_RESET
	bool "Sleep 20ms after VENC reset"
	default y
	help
	  There is a 20ms sleep after VENC reset which seemed to fix the
	  reset. The reason for the bug is unclear, and it's also unclear
	  on what platforms this happens.

	  This option enables the sleep, and is enabled by default. You can
	  disable the sleep if it doesn't cause problems on your platform.

config OMAP2_FIFO_LOW_THRESHOLD
	int "FIFO threshold"
	range 1 10
	default 2 # James: original default is 1
	help
	  FIFO threshold value
	  for resolution lesser than 1280 * 720 = 1,
	  for resolution greater than 720P it is 2.
	  (CSR: OMAPS00260116)

config OMAP4_DSS_FIFO_WORKAROUND
	bool "OMAP4 DSS fifo workaround"
	depends on ARCH_OMAP4
	default y
	help
	  The GFX fifo on OMAP4 is smaller than the other fifos. The small fifo
	  causes problems with certain use cases, like using the tiler in 2D
	  mode. The below hack swaps the fifos of GFX and WB planes, thus
	  giving GFX plane a larger fifo. WB but should work fine with a
	  smaller fifo.

config OMAP4_DSS_FIFO_WORKAROUND_DEBUG
	bool "Enable debug logs for OMAP4 DSS fifo workaround"
	depends on OMAP4_DSS_FIFO_WORKAROUND
	default n
	help
	  Enable debug logs for OMAP4 DSS fifo workaround

config OMAP4_DSS_FIFO_UNDERFLOW_WORKAROUND
	bool "OMAP4 DSS fifo underflow workaround"
	depends on OMAP4_DSS_FIFO_WORKAROUND
	default n
	help
	  1. Assign fifos of WB plane to GFX plane.
	  2. Make the FIFO high threshold is higher than the FIFO size and avoid
	  the DMA engine stops requesting encoded pixels.

endif
```
